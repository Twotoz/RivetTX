## main/Kconfig.projbuild
```kconfig
menu "RivetTX hardware"

config RIVETTX_OPENPOCKET_OSD
    bool "Use OpenPocket AT7456E analog OSD instead of SSD1306"
    default n
    help
        Select exactly one presentation owner. When enabled, RivetTX uses
        the 30x16 OpenPocket character compositor and AT7456E video overlay;
        it does not initialize the SSD1306 OLED.

config RIVETTX_OPENPOCKET_REV_A
    bool "OpenPocket Revision-A integrated ESP32-S3 board"
    default n
    depends on IDF_TARGET_ESP32S3 && RIVETTX_OPENPOCKET_OSD
    help
        Enables the integrated charger, MAX17048 gauge, three switched 5 V
        domains, AMT630A status and direct flash recovery, backlight PWM,
        non-blocking buzzer/I2S audio, and two I2C control
        expanders. Revision A uses native USB and requires no PSRAM.

config RIVETTX_BOARD_I2C_SDA_GPIO
    int "Revision-A board I2C SDA GPIO"
    range 0 48
    default 15
    depends on RIVETTX_OPENPOCKET_REV_A

config RIVETTX_BOARD_I2C_SCL_GPIO
    int "Revision-A board I2C SCL GPIO"
    range 0 48
    default 16
    depends on RIVETTX_OPENPOCKET_REV_A

config RIVETTX_5V_VIDEO_ENABLE_EXPANDER_BIT
    int "5V_VIDEO load-switch enable expander bit"
    range 16 31
    default 24
    depends on RIVETTX_OPENPOCKET_REV_A

config RIVETTX_5V_DISPLAY_ENABLE_EXPANDER_BIT
    int "5V_DISPLAY load-switch enable expander bit"
    range 16 31
    default 25
    depends on RIVETTX_OPENPOCKET_REV_A

config RIVETTX_5V_ELRS_ENABLE_EXPANDER_BIT
    int "5V_ELRS load-switch enable expander bit"
    range 16 31
    default 26
    depends on RIVETTX_OPENPOCKET_REV_A

config RIVETTX_SDMMC_ENABLED
    bool "OpenPocket removable microSD storage"
    default y
    depends on RIVETTX_OPENPOCKET_REV_A

config RIVETTX_SD_CLK_GPIO
    int "SDMMC 1-bit CLK GPIO"
    range 0 48
    default 40
    depends on RIVETTX_OPENPOCKET_REV_A

config RIVETTX_SD_CMD_GPIO
    int "SDMMC 1-bit CMD GPIO"
    range 0 48
    default 41
    depends on RIVETTX_OPENPOCKET_REV_A

config RIVETTX_SD_D0_GPIO
    int "SDMMC 1-bit DAT0 GPIO"
    range 0 48
    default 42
    depends on RIVETTX_OPENPOCKET_REV_A

config RIVETTX_SD_DETECT_EXPANDER_BIT
    int "Active-low microSD card-detect expander bit"
    range 16 31
    default 22
    depends on RIVETTX_OPENPOCKET_REV_A

config RIVETTX_SD_POWER_EXPANDER_BIT
    int "3V3_SD load-switch enable expander bit"
    range 16 31
    default 23
    depends on RIVETTX_OPENPOCKET_REV_A

config RIVETTX_SD_INITIAL_CLOCK_KHZ
    int "Initial SD identification clock (kHz)"
    range 100 1000
    default 400
    depends on RIVETTX_SDMMC_ENABLED

config RIVETTX_SD_MAX_CLOCK_KHZ
    int "Maximum Revision-A SD clock (kHz)"
    range 1000 20000
    default 20000
    depends on RIVETTX_SDMMC_ENABLED

config RIVETTX_SD_DETECT_DEBOUNCE_MS
    int "microSD card-detect debounce (milliseconds)"
    range 20 500
    default 80
    depends on RIVETTX_SDMMC_ENABLED

config RIVETTX_BACKLIGHT_PWM_GPIO
    int "TPS61165 backlight PWM GPIO"
    range 0 48
    default 47
    depends on RIVETTX_OPENPOCKET_REV_A

config RIVETTX_BACKLIGHT_DEFAULT_PERCENT
    int "Default TFT backlight percentage"
    range 0 100
    default 60
    depends on RIVETTX_OPENPOCKET_REV_A

config RIVETTX_DISPLAY_CONTROLLER_RESET_GPIO
    int "AMT630A active-low reset GPIO"
    range 0 48
    default 38
    depends on RIVETTX_OPENPOCKET_REV_A

config RIVETTX_AMT630A_I2C_ADDRESS
    hex "AMT630A global-register I2C address"
    default 0x58
    depends on RIVETTX_OPENPOCKET_REV_A

config RIVETTX_AMT630A_FLASH_TIMEOUT_MS
    int "AMT630A flash operation timeout (milliseconds)"
    range 100 30000
    default 10000
    depends on RIVETTX_OPENPOCKET_REV_A

config RIVETTX_AMT630A_FLASH_CS_GPIO
    int "AMT630A recovery-flash CS GPIO"
    range 0 48
    default 26
    depends on RIVETTX_OPENPOCKET_REV_A

config RIVETTX_AMT630A_FLASH_CLK_GPIO
    int "AMT630A recovery-flash CLK GPIO"
    range 0 48
    default 33
    depends on RIVETTX_OPENPOCKET_REV_A

config RIVETTX_AMT630A_FLASH_MOSI_GPIO
    int "AMT630A recovery-flash MOSI GPIO"
    range 0 48
    default 34
    depends on RIVETTX_OPENPOCKET_REV_A

config RIVETTX_AMT630A_FLASH_MUX_GPIO
    int "AMT630A flash owner mux-select GPIO"
    range 0 48
    default 36
    depends on RIVETTX_OPENPOCKET_REV_A

config RIVETTX_AMT630A_FLASH_MISO_GPIO
    int "AMT630A recovery-flash MISO GPIO"
    range 0 48
    default 37
    depends on RIVETTX_OPENPOCKET_REV_A

config RIVETTX_SPEAKER_I2S_BCLK_GPIO
    int "NS4168 I2S BCLK GPIO"
    range 0 48
    default 39
    depends on RIVETTX_OPENPOCKET_REV_A

config RIVETTX_SPEAKER_I2S_WS_GPIO
    int "NS4168 I2S word-select GPIO"
    range 0 48
    default 45
    depends on RIVETTX_OPENPOCKET_REV_A

config RIVETTX_SPEAKER_I2S_DATA_GPIO
    int "NS4168 I2S data GPIO"
    range 0 48
    default 46
    depends on RIVETTX_OPENPOCKET_REV_A

config RIVETTX_SPEAKER_ENABLE_GPIO
    int "NS4168 active-high shutdown-release GPIO"
    range 0 48
    default 6
    depends on RIVETTX_OPENPOCKET_REV_A

config RIVETTX_VBUS_DETECT_GPIO
    int "USB VBUS detect GPIO"
    range 0 48
    default 48
    depends on RIVETTX_OPENPOCKET_REV_A

config RIVETTX_CONTROL_EXPANDER0_ADDRESS
    hex "First TCA9535 control-expander address"
    default 0x20
    depends on RIVETTX_OPENPOCKET_REV_A

config RIVETTX_CONTROL_EXPANDER1_ADDRESS
    hex "Second TCA9535 control-expander address"
    default 0x21
    depends on RIVETTX_OPENPOCKET_REV_A

config RIVETTX_CONTROL_EXPANDER_INT_GPIO
    int "Control-expander interrupt GPIO"
    range 0 48
    default 10
    depends on RIVETTX_OPENPOCKET_REV_A

config RIVETTX_CHARGER_INT_GPIO
    int "BQ25895 active-low interrupt GPIO"
    range 0 48
    default 43
    depends on RIVETTX_OPENPOCKET_REV_A

config RIVETTX_FUEL_GAUGE_ALERT_GPIO
    int "MAX17048 active-low ALERT GPIO"
    range 0 48
    default 44
    depends on RIVETTX_OPENPOCKET_REV_A

config RIVETTX_BOARD_POWER_SAMPLE_INTERVAL_MS
    int "Charger and fuel-gauge sample interval (milliseconds)"
    range 20 2000
    default 100
    depends on RIVETTX_OPENPOCKET_REV_A

config RIVETTX_AT7456E_SCLK_GPIO
    int "AT7456E SPI clock GPIO"
    range -1 21 if IDF_TARGET_ESP32C3
    range -1 48 if IDF_TARGET_ESP32S3
    default -1
    depends on RIVETTX_OPENPOCKET_OSD

config RIVETTX_AT7456E_MOSI_GPIO
    int "AT7456E SPI MOSI / SDIN GPIO"
    range -1 21 if IDF_TARGET_ESP32C3
    range -1 48 if IDF_TARGET_ESP32S3
    default -1
    depends on RIVETTX_OPENPOCKET_OSD

config RIVETTX_AT7456E_MISO_GPIO
    int "AT7456E SPI MISO / SDOUT GPIO"
    range -1 21 if IDF_TARGET_ESP32C3
    range -1 48 if IDF_TARGET_ESP32S3
    default -1
    depends on RIVETTX_OPENPOCKET_OSD

config RIVETTX_AT7456E_CS_GPIO
    int "AT7456E active-low chip-select GPIO"
    range -1 21 if IDF_TARGET_ESP32C3
    range -1 48 if IDF_TARGET_ESP32S3
    default -1
    depends on RIVETTX_OPENPOCKET_OSD

config RIVETTX_AT7456E_RESET_GPIO
    int "AT7456E active-low reset GPIO (-1 uses software reset)"
    range -1 21 if IDF_TARGET_ESP32C3
    range -1 48 if IDF_TARGET_ESP32S3
    default -1
    depends on RIVETTX_OPENPOCKET_OSD

config RIVETTX_AT7456E_SPI_CLOCK_HZ
    int "AT7456E SPI clock (Hz)"
    range 100000 10000000
    default 8000000
    depends on RIVETTX_OPENPOCKET_OSD

config RIVETTX_AT7456E_CS_SETUP_CYCLES
    int "AT7456E CS setup time (SPI clock cycles)"
    range 1 16
    default 1
    depends on RIVETTX_OPENPOCKET_OSD

config RIVETTX_AT7456E_CS_HOLD_CYCLES
    int "AT7456E CS hold time (SPI clock cycles)"
    range 1 16
    default 1
    depends on RIVETTX_OPENPOCKET_OSD

config RIVETTX_RX5808_ENABLED
    bool "Enable physical RX5808 / RTC6715 receiver"
    default n
    depends on RIVETTX_OPENPOCKET_OSD
    help
        Enables the non-blocking three-wire RTC6715 tuner and RSSI ADC for
        OpenPocket. The module must expose an SPI-enabled RTC6715 interface;
        stock RX5808 modules may require the documented SPI modification.

config RIVETTX_RX5808_DATA_GPIO
    int "RX5808 DATA GPIO"
    range -1 21 if IDF_TARGET_ESP32C3
    range -1 48 if IDF_TARGET_ESP32S3
    default -1
    depends on RIVETTX_RX5808_ENABLED

config RIVETTX_RX5808_CLK_GPIO
    int "RX5808 CLK GPIO"
    range -1 21 if IDF_TARGET_ESP32C3
    range -1 48 if IDF_TARGET_ESP32S3
    default -1
    depends on RIVETTX_RX5808_ENABLED

config RIVETTX_RX5808_LE_GPIO
    int "RX5808 LE / latch-enable GPIO"
    range -1 21 if IDF_TARGET_ESP32C3
    range -1 48 if IDF_TARGET_ESP32S3
    default -1
    depends on RIVETTX_RX5808_ENABLED

config RIVETTX_RX5808_RSSI_GPIO
    int "RX5808 RSSI ADC GPIO"
    range -1 4 if IDF_TARGET_ESP32C3
    range -1 10 if IDF_TARGET_ESP32S3
    default -1
    depends on RIVETTX_RX5808_ENABLED
    help
        Must be an ADC1-capable input. The RX5808 RSSI voltage must never
        exceed the selected ESP32 target's ADC input limit.

config RIVETTX_RX5808_TRANSITION_INTERVAL_US
    int "RX5808 serial transition interval (microseconds)"
    range 1 100
    default 2
    depends on RIVETTX_RX5808_ENABLED
    help
        Minimum spacing between DATA, CLK, and LE state-machine transitions.
        No busy-wait delay is used.

config RIVETTX_RX5808_TUNE_TIMEOUT_MS
    int "RX5808 tune timeout (milliseconds)"
    range 10 1000
    default 150
    depends on RIVETTX_RX5808_ENABLED

config RIVETTX_RX5808_SCAN_DWELL_MS
    int "RX5808 scan dwell / settle time (milliseconds)"
    range 20 1000
    default 80
    depends on RIVETTX_RX5808_ENABLED

config RIVETTX_RX5808_RSSI_SAMPLE_INTERVAL_MS
    int "RX5808 RSSI sample interval (milliseconds)"
    range 5 1000
    default 20
    depends on RIVETTX_RX5808_ENABLED

config RIVETTX_RX5808_RSSI_STALE_MS
    int "RX5808 RSSI stale timeout (milliseconds)"
    range 100 5000
    default 1000
    depends on RIVETTX_RX5808_ENABLED

config RIVETTX_RX5808_RSSI_MIN_ADC
    int "RX5808 RSSI noise/minimum ADC level"
    range 0 4094
    default 300
    depends on RIVETTX_RX5808_ENABLED

config RIVETTX_RX5808_RSSI_MAX_ADC
    int "RX5808 RSSI maximum-signal ADC level"
    range 1 4095
    default 3000
    depends on RIVETTX_RX5808_ENABLED

config RIVETTX_RX5808_RSSI_FILTER_SHIFT
    int "RX5808 RSSI IIR filter shift"
    range 0 8
    default 3
    depends on RIVETTX_RX5808_ENABLED
    help
        Zero disables smoothing. Higher values increase smoothing and delay.

config RIVETTX_RX5808_RSSI_HYSTERESIS_PERCENT
    int "RX5808 displayed RSSI hysteresis (percent)"
    range 0 20
    default 2
    depends on RIVETTX_RX5808_ENABLED

config RIVETTX_I2C_SDA
    int "OLED I2C SDA GPIO"
    range 0 21 if IDF_TARGET_ESP32C3
    range 0 48 if IDF_TARGET_ESP32S3
    default 4 if IDF_TARGET_ESP32C3
    default 8 if IDF_TARGET_ESP32S3

config RIVETTX_I2C_SCL
    int "OLED I2C SCL GPIO"
    range 0 21 if IDF_TARGET_ESP32C3
    range 0 48 if IDF_TARGET_ESP32S3
    default 5 if IDF_TARGET_ESP32C3
    default 9 if IDF_TARGET_ESP32S3

config RIVETTX_OLED_ADDRESS
    hex "OLED I2C address"
    default 0x3C

config RIVETTX_CRSF_TX
    int "CRSF UART TX GPIO"
    range 0 21 if IDF_TARGET_ESP32C3
    range 0 48 if IDF_TARGET_ESP32S3
    default 6 if IDF_TARGET_ESP32C3
    default 17 if IDF_TARGET_ESP32S3

config RIVETTX_CRSF_RX
    int "CRSF UART RX GPIO"
    range 0 21 if IDF_TARGET_ESP32C3
    range 0 48 if IDF_TARGET_ESP32S3
    default 7 if IDF_TARGET_ESP32C3
    default 18 if IDF_TARGET_ESP32S3

config RIVETTX_AXIS0_GPIO
    int "Axis 0 ADC GPIO"
    range 0 4 if IDF_TARGET_ESP32C3
    range 1 10 if IDF_TARGET_ESP32S3
    default 0 if IDF_TARGET_ESP32C3
    default 1 if IDF_TARGET_ESP32S3

config RIVETTX_AXIS1_GPIO
    int "Axis 1 ADC GPIO"
    range 0 4 if IDF_TARGET_ESP32C3
    range 1 10 if IDF_TARGET_ESP32S3
    default 1 if IDF_TARGET_ESP32C3
    default 2 if IDF_TARGET_ESP32S3

config RIVETTX_AXIS2_GPIO
    int "Axis 2 ADC GPIO"
    range 0 4 if IDF_TARGET_ESP32C3
    range 1 10 if IDF_TARGET_ESP32S3
    default 2 if IDF_TARGET_ESP32C3
    default 3 if IDF_TARGET_ESP32S3

config RIVETTX_AXIS3_GPIO
    int "Axis 3 ADC GPIO"
    range 0 4 if IDF_TARGET_ESP32C3
    range 1 10 if IDF_TARGET_ESP32S3
    default 3 if IDF_TARGET_ESP32C3
    default 4 if IDF_TARGET_ESP32S3

config RIVETTX_AXIS4_GPIO
    int "Axis 4 / left scroll wheel ADC GPIO (-1 disables)"
    range -1 4 if IDF_TARGET_ESP32C3
    range -1 10 if IDF_TARGET_ESP32S3
    default -1

config RIVETTX_AXIS5_GPIO
    int "Axis 5 / right scroll wheel ADC GPIO (-1 disables)"
    range -1 4 if IDF_TARGET_ESP32C3
    range -1 10 if IDF_TARGET_ESP32S3
    default -1

config RIVETTX_AXIS6_GPIO
    int "Axis 6 / pot or slider ADC GPIO (-1 disables)"
    range -1 4 if IDF_TARGET_ESP32C3
    range -1 10 if IDF_TARGET_ESP32S3
    default -1

config RIVETTX_AXIS7_GPIO
    int "Axis 7 / pot or slider ADC GPIO (-1 disables)"
    range -1 4 if IDF_TARGET_ESP32C3
    range -1 10 if IDF_TARGET_ESP32S3
    default -1

config RIVETTX_BUTTON_UP
    int "Up button GPIO"
    range -1 21 if IDF_TARGET_ESP32C3
    range -1 48 if IDF_TARGET_ESP32S3
    default 8 if IDF_TARGET_ESP32C3
    default 10 if IDF_TARGET_ESP32S3

config RIVETTX_BUTTON_DOWN
    int "Down button GPIO"
    range -1 21 if IDF_TARGET_ESP32C3
    range -1 48 if IDF_TARGET_ESP32S3
    default 9 if IDF_TARGET_ESP32C3
    default 11 if IDF_TARGET_ESP32S3

config RIVETTX_BUTTON_ENTER
    int "Enter button GPIO"
    range -1 21 if IDF_TARGET_ESP32C3
    range -1 48 if IDF_TARGET_ESP32S3
    default 10 if IDF_TARGET_ESP32C3
    default 12 if IDF_TARGET_ESP32S3

config RIVETTX_BUTTON_BACK
    int "Back/recovery button GPIO"
    range -1 21 if IDF_TARGET_ESP32C3
    range -1 48 if IDF_TARGET_ESP32S3
    default 20 if IDF_TARGET_ESP32C3
    default 14 if IDF_TARGET_ESP32S3

config RIVETTX_AUX1_GPIO
    int "AUX1 / Betaflight ARM switch GPIO (-1 disables)"
    range -1 21 if IDF_TARGET_ESP32C3
    range -1 48 if IDF_TARGET_ESP32S3
    default -1
    help
        Connect a maintained two-position switch between this GPIO and
        ground. The input uses the internal pull-up, is active low, and the
        default model sends it on CH5/AUX1. Leave disabled until the board
        has a dedicated arming switch.

config RIVETTX_AUX2_GPIO
    int "AUX2 / Betaflight PREARM switch GPIO (-1 disables)"
    range -1 21 if IDF_TARGET_ESP32C3
    range -1 48 if IDF_TARGET_ESP32S3
    default -1
    help
        Active-low maintained switch sent on CH6/AUX2 by the default model.

config RIVETTX_AUX3_GPIO
    int "AUX3 / Betaflight mode switch GPIO (-1 disables)"
    range -1 21 if IDF_TARGET_ESP32C3
    range -1 48 if IDF_TARGET_ESP32S3
    default -1
    help
        Active-low maintained switch sent on CH7/AUX3 by the default model.

config RIVETTX_AUX4_GPIO
    int "AUX4 / Betaflight beeper switch GPIO (-1 disables)"
    range -1 21 if IDF_TARGET_ESP32C3
    range -1 48 if IDF_TARGET_ESP32S3
    default -1
    help
        Active-low maintained switch sent on CH8/AUX4 by the default model.

config RIVETTX_AUX2_LOW_GPIO
    int "AUX2 three-position LOW contact GPIO (-1 uses two-position)"
    range -1 21 if IDF_TARGET_ESP32C3
    range -1 48 if IDF_TARGET_ESP32S3
    default -1
    help
        When configured together with AUX2 GPIO, LOW active gives -100%,
        neither contact gives center, and AUX2 active gives +100%.

config RIVETTX_AUX3_LOW_GPIO
    int "AUX3 three-position LOW contact GPIO (-1 uses two-position)"
    range -1 21 if IDF_TARGET_ESP32C3
    range -1 48 if IDF_TARGET_ESP32S3
    default -1

config RIVETTX_AUX4_LOW_GPIO
    int "AUX4 three-position LOW contact GPIO (-1 uses two-position)"
    range -1 21 if IDF_TARGET_ESP32C3
    range -1 48 if IDF_TARGET_ESP32S3
    default -1

config RIVETTX_ENCODER_A_GPIO
    int "Menu rotary encoder A GPIO (-1 disables encoder)"
    range -1 21 if IDF_TARGET_ESP32C3
    range -1 48 if IDF_TARGET_ESP32S3
    default -1

config RIVETTX_ENCODER_B_GPIO
    int "Menu rotary encoder B GPIO (-1 disables encoder)"
    range -1 21 if IDF_TARGET_ESP32C3
    range -1 48 if IDF_TARGET_ESP32S3
    default -1

config RIVETTX_ENCODER_PRESS_GPIO
    int "Menu rotary encoder press GPIO (-1 disables press)"
    range -1 21 if IDF_TARGET_ESP32C3
    range -1 48 if IDF_TARGET_ESP32S3
    default -1

config RIVETTX_TRIM_AIL_NEG_GPIO
    int "Aileron trim left GPIO (-1 disables)"
    range -1 21 if IDF_TARGET_ESP32C3
    range -1 48 if IDF_TARGET_ESP32S3
    default -1

config RIVETTX_TRIM_AIL_POS_GPIO
    int "Aileron trim right GPIO (-1 disables)"
    range -1 21 if IDF_TARGET_ESP32C3
    range -1 48 if IDF_TARGET_ESP32S3
    default -1

config RIVETTX_TRIM_ELE_NEG_GPIO
    int "Elevator trim down GPIO (-1 disables)"
    range -1 21 if IDF_TARGET_ESP32C3
    range -1 48 if IDF_TARGET_ESP32S3
    default -1

config RIVETTX_TRIM_ELE_POS_GPIO
    int "Elevator trim up GPIO (-1 disables)"
    range -1 21 if IDF_TARGET_ESP32C3
    range -1 48 if IDF_TARGET_ESP32S3
    default -1

config RIVETTX_TRIM_THR_NEG_GPIO
    int "Throttle trim down GPIO (-1 disables)"
    range -1 21 if IDF_TARGET_ESP32C3
    range -1 48 if IDF_TARGET_ESP32S3
    default -1

config RIVETTX_TRIM_THR_POS_GPIO
    int "Throttle trim up GPIO (-1 disables)"
    range -1 21 if IDF_TARGET_ESP32C3
    range -1 48 if IDF_TARGET_ESP32S3
    default -1

config RIVETTX_TRIM_RUD_NEG_GPIO
    int "Rudder trim left GPIO (-1 disables)"
    range -1 21 if IDF_TARGET_ESP32C3
    range -1 48 if IDF_TARGET_ESP32S3
    default -1

config RIVETTX_TRIM_RUD_POS_GPIO
    int "Rudder trim right GPIO (-1 disables)"
    range -1 21 if IDF_TARGET_ESP32C3
    range -1 48 if IDF_TARGET_ESP32S3
    default -1

config RIVETTX_BATTERY_GPIO
    int "Battery ADC GPIO (-1 disables battery sensing)"
    range -1 4 if IDF_TARGET_ESP32C3
    range -1 10 if IDF_TARGET_ESP32S3
    default -1

config RIVETTX_BATTERY_DIVIDER_MILLI
    int "Battery divider multiplier x1000"
    range 1000 10000
    default 2000

config RIVETTX_BATTERY_LOW_MV
    int "Transmitter battery low warning (mV)"
    range 1100 30000
    default 3500
    help
        Set this for the complete transmitter battery pack. It must be
        higher than the critical threshold.

config RIVETTX_BATTERY_CRITICAL_MV
    int "Transmitter battery critical warning (mV)"
    range 1000 30000
    default 3200
    help
        At or below this voltage RivetTX locks outputs as well as playing
        the critical battery pattern.

config RIVETTX_BUZZER_GPIO
    int "Passive piezo buzzer GPIO (-1 disables audio)"
    range -1 21 if IDF_TARGET_ESP32C3
    range -1 48 if IDF_TARGET_ESP32S3
    default -1

config RIVETTX_BUZZER_VOLUME
    int "Passive piezo duty percentage"
    range 1 50
    default 25

config RIVETTX_LINK_WARNING_LQ
    int "ELRS weak-link warning threshold (LQ percent)"
    range 2 100
    default 70

config RIVETTX_LINK_CRITICAL_LQ
    int "ELRS critical-link warning threshold (LQ percent)"
    range 1 99
    default 30
    help
        Keep this lower than the weak-link threshold. Warnings use
        hysteresis and repeat faster as the link becomes critical.

config RIVETTX_WIFI_BACKUP
    bool "Enable maintenance Wi-Fi backup portal"
    default y

config RIVETTX_WIFI_PASSWORD
    string "Maintenance AP password"
    default "change-rivettx"
    depends on RIVETTX_WIFI_BACKUP

endmenu
```
